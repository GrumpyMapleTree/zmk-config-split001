#include "split001.dtsi" //Shared between halves

&kscan0 {
        status = "okay";
        wakeup-source;
        row-gpios
            = <&mcp_io 0 (GPIO_ACTIVE_LOW | GPIO_PULL_UP)>
            , <&mcp_io 1 (GPIO_ACTIVE_LOW | GPIO_PULL_UP)>
            , <&mcp_io 2 (GPIO_ACTIVE_LOW | GPIO_PULL_UP)>
            , <&mcp_io 4 (GPIO_ACTIVE_LOW | GPIO_PULL_UP)>
            , <&mcp_io 6 (GPIO_ACTIVE_LOW | GPIO_PULL_UP)>
            ;
        col-gpios
            = <&mcp_io 3 (GPIO_ACTIVE_LOW | GPIO_PULL_UP)>
            , <&mcp_io 5 (GPIO_ACTIVE_LOW | GPIO_PULL_UP)>
            , <&mcp_io 7 (GPIO_ACTIVE_LOW | GPIO_PULL_UP)>
            , <&mcp_io 8 (GPIO_ACTIVE_LOW | GPIO_PULL_UP)>
            , <&mcp_io 9 (GPIO_ACTIVE_LOW | GPIO_PULL_UP)>
            , <&mcp_io 10 (GPIO_ACTIVE_LOW | GPIO_PULL_UP)>
            , <&mcp_io 11 (GPIO_ACTIVE_LOW | GPIO_PULL_UP)>
            , <&mcp_io 12 (GPIO_ACTIVE_LOW | GPIO_PULL_UP)>
            , <&mcp_io 13 (GPIO_ACTIVE_LOW | GPIO_PULL_UP)>
            , <&mcp_io 14 (GPIO_ACTIVE_LOW | GPIO_PULL_UP)>
            , <&mcp_io 15 (GPIO_ACTIVE_LOW | GPIO_PULL_UP)>
            ;

}

left_encoder: encoder_left {
        status = "okay";
        a-gpios = <&gpio0 8 (GPIO_ACTIVE_HIGH | GPIO_PULL_UP)>;
        b-gpios = <&gpio0 7 (GPIO_ACTIVE_HIGH | GPIO_PULL_UP)>;
    };


