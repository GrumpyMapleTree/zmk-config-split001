## config/boards/shields/split001/Kconfig.defconfig
```kconfig
if SHIELD_SPLIT001_LEFT

config ZMK_KEYBOARD_NAME
    default "Split001"

config ZMK_SPLIT_ROLE_CENTRAL
    default y
    
endif

if SHIELD_SPLIT001_LEFT || SHIELD_SPLIT001_RIGHT

config ZMK_SPLIT
    default y

endif
```

## config/boards/shields/split001/Kconfig.shield
```kconfig
config SHIELD_SPLIT001_LEFT
    def_bool $(shields_list_contains,split001_left)

config SHIELD_SPLIT001_RIGHT
    def_bool $(shields_list_contains,split001_right)
```
